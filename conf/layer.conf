## conf/layer.conf
```bitbake
# We have a conf and classes directory, add to BBPATH
BBPATH .= ":${LAYERDIR}"

# We have a packages directory, add to BBFILES
BBFILES += "${LAYERDIR}/recipes-*/*/*.bb ${LAYERDIR}/recipes-*/*/*.bbappend"

BBFILE_COLLECTIONS += "intechos-layer"
BBFILE_PATTERN_intechos-layer := "^${LAYERDIR}/"
BBFILE_PRIORITY_intechos-layer = "6"
```
